## Documentation/devicetree/bindings/iio/adc/sun4i-gpadc.txt
```
Allwinner SoCs' GPADC Device Tree bindings
------------------------------------------
The Allwinner SoCs all have an ADC that can also act as a thermal sensor
and sometimes as a touchscreen controller.

Required properties:
  - compatible: must contain one of the following compatibles:
		- "allwinner,sun8i-a33-ths"
		- "allwinner,sun8i-h3-ths"
		- "allwinner,sun8i-a83t-ths"
  - reg: mmio address range of the chip,
  - #thermal-sensor-cells:
		Please refer <devicetree/bindings/thermal/thermal.txt>,
  - #io-channel-cells: shall be 0,

Required properties for the following compatibles:
		- "allwinner,sun8i-h3-ths"
		- "allwinner,sun8i-a83t-ths"
  - interrupts: the sampling interrupt of the ADC,

Required properties for the following compatibles:
		- "allwinner,sun8i-h3-ths"
  - clocks: the bus clock and the input clock of the ADC,
  - clock-names: should be "bus" and "mod",
  - resets: the bus reset of the ADC,

Optional properties for the following compatibles:
		- "allwinner,sun8i-h3-ths"
		- "allwinner,sun8i-a83t-ths"
  - nvmem-cells: A phandle to the calibration data provided by a nvmem device.
  - nvmem-cell-names: Should be "calibration".

Details see: bindings/nvmem/nvmem.txt

Example for A33:
	ths: ths@1c25000 {
		compatible = "allwinner,sun8i-a33-ths";
		reg = <0x01c25000 0x100>;
		#thermal-sensor-cells = <0>;
		#io-channel-cells = <0>;
	};

Example for H3:
	ths: thermal-sensor@1c25000 {
		compatible = "allwinner,sun8i-h3-ths";
		reg = <0x01c25000 0x400>;
		clocks = <&ccu CLK_BUS_THS>, <&ccu CLK_THS>;
		clock-names = "bus", "mod";
		resets = <&ccu RST_BUS_THS>;
		interrupts = <GIC_SPI 31 IRQ_TYPE_LEVEL_HIGH>;
		#thermal-sensor-cells = <0>;
		#io-channel-cells = <0>;
	};

sun4i, sun5i and sun6i SoCs are also supported via these bindings:

Required properties:
 - compatible: "allwinner,sun4i-a10-gpadc", "allwinner,sun5i-a13-gpadc" or
   "allwinner,sun6i-a31-gpadc"
 - reg: mmio address range of the chip
 - interrupts: interrupt to which the chip is connected
 - #thermal-sensor-cells: shall be 0

Example:

	gpadc: gpadc@1c25000 {
		compatible = "allwinner,sun4i-a10-gpadc";
		reg = <0x01c25000 0x100>;
		interrupts = <29>;
		#thermal-sensor-cells = <0>;
	};
```
